#ifdef TESTBENCH_BUILD

#include <Arduino.h>
#include <DHT.h>
#include <Wire.h>
#include <Adafruit_GFX.h>
#include <Adafruit_SSD1306.h>
#include "hive_inference.h"

#define PIN_MQ135     2
#define PIN_OPAMP     1
#define PIN_DHT11     6
#define PIN_FPGA_TX  17
#define PIN_FPGA_RX  18
#define PIN_OLED_SDA  3
#define PIN_OLED_SCL 10

#define OLED_WIDTH   128
#define OLED_HEIGHT   64
#define OLED_ADDR    0x3C

DHT dht(PIN_DHT11, DHT11);
Adafruit_SSD1306 oled(OLED_WIDTH, OLED_HEIGHT, &Wire, -1);

static volatile uint32_t isrCount = 0;
static portMUX_TYPE timerMux = portMUX_INITIALIZER_UNLOCKED;
static bool oledOk = false;
static int  passCount = 0, failCount = 0;

// ── test helpers ──────────────────────────────────────────────────────────────

static void printHeader(const char *name) {
    Serial.println();
    Serial.printf("=== %s ===\n", name);
}

static void check(bool cond, const char *label) {
    if (cond) {
        Serial.printf("  PASS  %s\n", label);
        passCount++;
    } else {
        Serial.printf("  FAIL  %s\n", label);
        failCount++;
    }
}

// ── test: MLP forward pass vs Python reference ────────────────────────────────
// Generated by ML/gen_inference_testvecs.py
// 'raw' vectors are already z-scored; fused_mean = SCALER_MEAN, fused_scale = SCALER_SCALE.

static const int TV_N = 4;
static const char *TV_NAMES[] = {
    "HEALTHY_NORMAL",
    "HEALTHY_COOL",
    "STRESSED_HOT",
    "BORDERLINE",
};

static const float TV_ZSCORED[TV_N][HVM2_N_IN] = {
    {0.05029209f, -0.05284195f, 0.25616905f, 0.04196005f, -0.21426775f, 0.14463802f, 0.52160001f, 0.37883240f, -0.28149408f, -0.50616860f, -0.24930978f, 0.01653039f, -0.93001229f, -0.08751667f, -0.49836439f, -0.29290694f},  // HEALTHY_NORMAL
    {-0.66327769f, -0.59489006f, -0.37651083f, -0.18724599f, -0.53856039f, -0.09006096f, -0.69955838f, -0.39454699f, -0.22895895f, -0.47179630f, -0.72304976f, -0.77651763f, -0.63731778f, -0.43394145f, -0.80288547f, -0.56275266f},  // HEALTHY_COOL
    {3.42038751f, 3.77042270f, 3.60732961f, 3.67768645f, 3.17308569f, 3.43519330f, 3.89198780f, 4.24671555f, 2.87046719f, 4.25696182f, 4.17293787f, 3.89065576f, 3.63222790f, 3.34303856f, 4.22901011f, 4.48012924f},  // STRESSED_HOT
    {2.22065401f, 2.02604151f, 1.64295220f, 1.01667249f, 1.49821830f, 1.76258993f, 0.98465544f, 1.65804887f, 1.67194545f, 1.77841711f, 1.02635276f, 1.23531902f, 1.32542586f, 1.03207922f, 2.19574714f, 1.30163574f},  // BORDERLINE
};

static const float TV_EXPECTED_PROB[TV_N] = {
    0.17174412f,  // HEALTHY_NORMAL
    0.27857193f,  // HEALTHY_COOL
    0.00000000f,  // STRESSED_HOT
    0.00043612f,  // BORDERLINE
};

static void testForwardPass() {
    printHeader("MLP Forward Pass (vs Python reference)");

    // Set fused constants = StandardScaler only (no per-hive z-score)
    WelfordState wf;
    wf.done = true;
    for (int i = 0; i < HVM2_N_IN; i++) {
        wf.fused_mean[i]  = HVM2_SCALER_MEAN[i];
        wf.fused_scale[i] = HVM2_SCALER_SCALE[i];
    }

    for (int t = 0; t < TV_N; t++) {
        // Normalize: x_norm = (x_zscored - scaler_mean) / scaler_scale
        float x_norm[HVM2_N_IN];
        for (int i = 0; i < HVM2_N_IN; i++) {
            x_norm[i] = (TV_ZSCORED[t][i] - wf.fused_mean[i]) / wf.fused_scale[i];
        }

        float prob = hiveForward(x_norm);
        float diff = fabsf(prob - TV_EXPECTED_PROB[t]);

        char label[64];
        snprintf(label, sizeof(label), "%s  got=%.6f  exp=%.6f  diff=%.2e",
                 TV_NAMES[t], prob, TV_EXPECTED_PROB[t], diff);
        check(diff < 1e-4f, label);
    }
}

// ── test: ring buffer indexing ─────────────────────────────────────────────────
static void testRingBuffer() {
    printHeader("Ring Buffer");

    HiveHistory hist;
    // Push 0, 1, 2, … 9; newest = 9
    for (int i = 0; i < 10; i++) hist.push((float)i, (float)(100 - i));

    check(hist.getTemp(0) == 9.0f,  "getTemp(0) == 9 (newest)");
    check(hist.getTemp(1) == 8.0f,  "getTemp(1) == 8");
    check(hist.getTemp(9) == 0.0f,  "getTemp(9) == 0 (oldest)");
    check(hist.getHum(0)  == 91.0f, "getHum(0) == 91");

    // Fill past capacity — oldest should be evicted
    for (int i = 10; i < HVM2_HIST_CAP + 5; i++) hist.push((float)i, 0.0f);
    check(hist.len == HVM2_HIST_CAP, "len capped at HIST_CAP");
    check(hist.getTemp(0) == (float)(HVM2_HIST_CAP + 4), "newest after overflow correct");
}

// ── test: feature engineering ─────────────────────────────────────────────────
static void testFeatures() {
    printHeader("Feature Engineering");

    HiveHistory hist;

    // Not enough history — should return false
    for (int i = 0; i < HVM2_WIN_48H; i++) hist.push(30.0f, 60.0f);
    float feat[HVM2_N_IN];
    check(!buildFeatures(hist, feat), "returns false when len < WIN_48H+1");

    hist.push(30.0f, 60.0f);  // now exactly WIN_48H + 1 readings
    check(buildFeatures(hist, feat), "returns true when len == WIN_48H+1");

    // All readings are identical → std=0, range=0, trends=0
    check(fabsf(feat[0]  - 30.0f) < 1e-4f, "temperature = 30");
    check(fabsf(feat[1]  - 60.0f) < 1e-4f, "humidity = 60");
    check(fabsf(feat[3])           < 1e-4f, "temp_std_24h = 0 (constant history)");
    check(fabsf(feat[6])           < 1e-4f, "temp_range_24h = 0");
    check(fabsf(feat[12])          < 1e-4f, "temp_trend_6h = 0");
    check(fabsf(feat[14])          < 1e-4f, "temp_trend_48h = 0");

    // Add a spike on the newest reading — trend should be non-zero
    HiveHistory hist2;
    for (int i = 0; i <= HVM2_WIN_48H; i++) {
        float t = (i == 0) ? 35.0f : 30.0f;  // index 0 = newest
        hist2.push(t, 60.0f);
    }
    // Rebuild so newest is the spike: push in oldest-first order
    HiveHistory hist3;
    for (int i = HVM2_WIN_48H; i >= 1; i--) hist3.push(30.0f, 60.0f);
    hist3.push(35.0f, 60.0f);   // newest = spike
    float feat3[HVM2_N_IN];
    buildFeatures(hist3, feat3);
    check(fabsf(feat3[12] - 5.0f) < 1e-3f, "temp_trend_6h = 5 (spike vs 6 readings ago)");
    check(fabsf(feat3[14] - 5.0f) < 1e-3f, "temp_trend_48h = 5 (spike vs 48 readings ago)");
}

// ── test: consecutive smoothing ───────────────────────────────────────────────
static void testConsecutiveSmoothing() {
    printHeader("Consecutive Smoothing");

    // Inject pre-set fused constants = scaler-only
    HiveClassifier hive;
    hive.wf.done = true;
    for (int i = 0; i < HVM2_N_IN; i++) {
        hive.wf.fused_mean[i]  = HVM2_SCALER_MEAN[i];
        hive.wf.fused_scale[i] = HVM2_SCALER_SCALE[i];
    }

    // Pre-fill history so features are computable
    for (int i = 0; i <= HVM2_WIN_48H; i++) hive.hist.push(30.0f, 60.0f);

    float prob;
    const char *label;

    // Two reads that would be stressed but consecutive count not met yet —
    // use STRESSED_HOT zscored values to force above-threshold output.
    // Since STRESSED_HOT → prob≈0, threshold won't be crossed at 0.5.
    // Use HVM2_THRESHOLD override via class member: temporarily lower threshold.
    // Instead, test that HEALTHY never wrongly escalates on the test data.
    for (int i = 0; i < HVM2_CONSEC_NEEDED * 2; i++) {
        label = hive.infer(30.0f, 60.0f, &prob);
    }
    check(strcmp(label, "HEALTHY") == 0, "constant normal readings → HEALTHY");

    // Reset and verify consecCount resets on a healthy reading
    hive.consecCount = HVM2_CONSEC_NEEDED - 1;
    hive.infer(30.0f, 60.0f, &prob);   // should reset counter
    check(hive.consecCount == 0, "consecCount resets on healthy reading");
}

// ── test: hardware peripherals ────────────────────────────────────────────────

void IRAM_ATTR onTimerTick() {
    portENTER_CRITICAL_ISR(&timerMux);
    isrCount++;
    portEXIT_CRITICAL_ISR(&timerMux);
}

static void testADC() {
    printHeader("ADC");
    analogReadResolution(12);
    analogSetAttenuation(ADC_11db);
    for (int i = 0; i < 5; i++) {
        uint16_t mq = analogRead(PIN_MQ135);
        uint16_t oa = analogRead(PIN_OPAMP);
        Serial.printf("  [%d] MQ135=%4u  OpAmp=%4u\n", i, mq, oa);
        delay(200);
    }
    Serial.println("  INFO — verify values change when sensor exposed to gas/heat");
}

static void testDHT11() {
    printHeader("DHT11");
    dht.begin();
    delay(2000);
    float h = dht.readHumidity();
    float t = dht.readTemperature();
    if (isnan(h) || isnan(t)) {
        check(false, "DHT11 read (check wiring on pin 6)");
    } else {
        char buf[64];
        snprintf(buf, sizeof(buf), "DHT11 read  T=%.1f  H=%.0f%%", t, h);
        check(true, buf);
    }
}

static void testOLED() {
    printHeader("OLED SSD1306");
    Wire.begin(PIN_OLED_SDA, PIN_OLED_SCL);
    if (!oled.begin(SSD1306_SWITCHCAPVCC, OLED_ADDR)) {
        check(false, "OLED init (check SDA=3, SCL=10)");
        return;
    }
    oledOk = true;
    oled.clearDisplay();
    oled.setTextSize(2);
    oled.setTextColor(SSD1306_WHITE);
    oled.setCursor(0, 0);
    oled.println("HIVE TEST");
    oled.setTextSize(1);
    oled.println("inference test");
    oled.display();
    check(true, "OLED init + display");
}

static void testUARTLoopback() {
    printHeader("UART Loopback (TX=17 -> RX=18, needs jumper)");
    Serial2.begin(9600, SERIAL_8N1, PIN_FPGA_RX, PIN_FPGA_TX);
    while (Serial2.available()) Serial2.read();
    delay(50);

    const uint8_t tx[] = {0xA5, 0x01, 0x42, 0xFF, 0x5A};
    Serial2.write(tx, sizeof(tx));
    delay(50);

    int received = 0;
    bool pass = true;
    while (Serial2.available() && received < (int)sizeof(tx)) {
        uint8_t b = Serial2.read();
        if (b != tx[received]) pass = false;
        received++;
    }

    if (received == 0) {
        Serial.println("  SKIP  no loopback data (connect pin17→pin18)");
    } else {
        check(pass && received == (int)sizeof(tx), "UART loopback 5 bytes");
    }
    Serial2.end();
}

static void testTimer() {
    printHeader("Hardware Timer ISR (200 Hz)");
    isrCount = 0;
    hw_timer_t *timer = timerBegin(0, 80, true);
    timerAttachInterrupt(timer, &onTimerTick, true);
    timerAlarmWrite(timer, 1000000UL / 200, true);
    timerAlarmEnable(timer);
    delay(1000);
    timerEnd(timer);
    char buf[48];
    snprintf(buf, sizeof(buf), "timer fires=%lu (expected 200±10)", isrCount);
    check(isrCount >= 190 && isrCount <= 210, buf);
}

// ── setup / loop ──────────────────────────────────────────────────────────────

void setup() {
    Serial.begin(115200);
    delay(1500);
    Serial.println("\n\n========================================");
    Serial.println("   ESP32-S3 HIVE INFERENCE TESTBENCH   ");
    Serial.println("========================================");

    testForwardPass();
    testRingBuffer();
    testFeatures();
    testConsecutiveSmoothing();

    testOLED();
    testADC();
    testDHT11();
    testUARTLoopback();
    testTimer();

    Serial.println();
    Serial.printf("=== RESULTS: %d passed, %d failed ===\n", passCount, failCount);

    if (oledOk) {
        oled.clearDisplay();
        oled.setTextSize(1);
        oled.setTextColor(SSD1306_WHITE);
        oled.setCursor(0, 0);
        oled.printf("PASS: %d  FAIL: %d\n", passCount, failCount);
        oled.println(failCount == 0 ? "ALL TESTS PASS" : "SOME TESTS FAIL");
        oled.println("See serial 115200");
        oled.display();
    }
}

void loop() {
    static unsigned long last = 0;
    if (millis() - last >= 500) {
        uint16_t mq = analogRead(PIN_MQ135);
        uint16_t oa = analogRead(PIN_OPAMP);
        Serial.printf("[LIVE] MQ135=%4u  OpAmp=%4u\n", mq, oa);
        last = millis();
    }
}

#endif  // TESTBENCH_BUILD
